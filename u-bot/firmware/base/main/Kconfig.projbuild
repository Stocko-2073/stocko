## u-bot/firmware/base/main/Kconfig.projbuild
```kconfig
menu "U-BOT base"

    comment "Pins are GPIO numbers on the XIAO ESP32-S3. Dn labels in DRIVE_MECHANISM.md."

    config UBOT_PIN_EN
        int "TMC2209 EN (both drivers, active low) -- D9"
        default 8
        help
            One pin for both drivers, on purpose: it is the hardware killswitch
            and it floats high (4.7k pull-up) so an MCU reset disables both.

    config UBOT_PIN_TMC_TX
        int "TMC2209 UART TX, through 1k to the shared node -- D6"
        default 43

    config UBOT_PIN_TMC_RX
        int "TMC2209 UART RX, on the node -- D7"
        default 44

    config UBOT_TMC_BAUD
        int "TMC2209 UART baud"
        default 250000
        help
            250000 or 500000. Writes fail below ~115200 (datagram longer than
            the driver's receive window) and address 1 does not answer at
            115200 with two drivers on the bus.

    config UBOT_TMC_ADDR_A
        int "Wheel A driver address (MS1/MS2)"
        default 0

    config UBOT_TMC_ADDR_B
        int "Wheel B driver address (MS1/MS2)"
        default 1

    config UBOT_PIN_ENC_A_SDA
        int "Wheel A AS5600 SDA (hardware I2C) -- D4"
        default 5

    config UBOT_PIN_ENC_A_SCL
        int "Wheel A AS5600 SCL (hardware I2C) -- D5"
        default 6

    config UBOT_PIN_ENC_B_SDA
        int "Wheel B AS5600 SDA (bit-banged) -- D2"
        default 3

    config UBOT_PIN_ENC_B_SCL
        int "Wheel B AS5600 SCL (bit-banged) -- D3"
        default 4

    config UBOT_PIN_BATT_ADC
        int "Battery sense ADC GPIO (ADC1) -- D1"
        default 2
        help
            Battery voltage through a divider. D1 is GPIO2 on the S3, which is
            ADC1 channel 1. Everything else is a runtime setting: the divider
            ratio (batt_div), and the pack (batt_pack), which chooses the
            percentage table and the warn and cutoff thresholds -- li5s, the
            5S Li-ion power-tool pack, by default, or lfp4s, the original 4S
            LiFePO4. Tables and rules are in components/battery/battery_model.c.

    config UBOT_CONTROL_HZ
        int "Servo control rate, Hz"
        default 200

    config UBOT_HW_REV_DEFAULT
        string "Hardware revision reported until 'hw set' stores one"
        default "A"

    config UBOT_NAME_DEFAULT
        string "Device name (mDNS host, BLE name) until 'set name' stores one"
        default "ubot"

    config UBOT_WEB_JOYSTICK
        bool "Serve a minimal joystick test page at http://ubot.local/"
        default y
        help
            A single HTML page that speaks the same WebSocket protocol the phone
            app will. Handy for driving from a laptop or a phone browser; costs
            ~14 KB of flash.

    config UBOT_BLE_ENABLE
        bool "Start BLE at boot"
        default y
        help
            Disable temporarily for Wi-Fi-only coexistence diagnostics. This
            skips Bluetooth controller and host initialization, including
            advertising; USB console and Wi-Fi remain available.

    config UBOT_BENCH_FAULTS
        bool "Bench fault injection (debug commands)"
        default n
        help
            Bench-only fault injection. Never in a build that drives outdoors.

            Adds the console command 'debug wedge <ms>', which stalls the
            control loop without feeding the task watchdog, to prove on the
            stand that a wedged loop resets the chip and EN floats high. Such
            a build says "BENCH FAULT INJECTION BUILD" at boot and in 'version'.

endmenu
```
